## conf/distro/xen-rpi.conf
```bitbake
# Author: Aananth C N
# Date: 29 May 2021, 10:28 AM (Saturday)
DISTRO = "xen-rpi"
DISTRO_NAME = "Xen Development Environment (Raspberry Pi)"
DISTRO_VERSION = "1.0"
DISTRO_CODENAME = "Valluvan"
MAINTAINER = "c.n.aananth@gmail.com"
```

## conf/layer.conf
```bitbake
# We have a conf and classes directory, append to BBPATH
BBPATH .= ":${LAYERDIR}"

# We have a recipes directory containing .bb and .bbappend files, add to BBFILES
BBFILES += "${LAYERDIR}/*/*.bb \
            ${LAYERDIR}/*/*.bbappend"

BBFILE_COLLECTIONS += "meta-virt-rpi"
BBFILE_PATTERN_meta-virt-rpi = "^${LAYERDIR}/"
BBFILE_PRIORITY_meta-virt-rpi = "10"

LAYERDEPENDS_meta-virt-rpi = "core"
LAYERSERIES_COMPAT_meta-virt-rpi = "dunfell"
```
